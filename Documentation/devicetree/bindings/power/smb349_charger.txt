## drivers/char/diag/Kconfig
```kconfig
menu "Diag Support"

config DIAG_CHAR
	tristate "char driver interface and diag forwarding to/from modem"
	default m
	depends on USB_G_ANDROID || USB_FUNCTION_DIAG || USB_QCOM_MAEMO
	depends on ARCH_MSM
	help
	 Char driver interface for diag user space and diag-forwarding to modem ARM and back.
	 This enables diagchar for maemo usb gadget or android usb gadget based on config selected.
endmenu

menu "DIAG traffic over USB"

config DIAG_OVER_USB
	bool "Enable DIAG traffic to go over USB"
        depends on ARCH_MSM
	default y
	help
	 This feature helps segregate code required for DIAG traffic to go over USB.
endmenu

menu "SLATE Support"

config LGE_SLATE
	bool "Enable SLATE Key Logging message routing"
		depends on DIAG_OVER_USB
	default n
	help
	 This feature helps decide whether slate key logging start message would be routed to apps or not.
endmenu

menu "SDIO support for DIAG"

config DIAG_SDIO_PIPE
	depends on MSM_SDIO_AL
	default y
	bool "Enable 9K DIAG traffic over SDIO"
	help
	 SDIO Transport Layer for DIAG Router
endmenu

menu "HSIC/SMUX support for DIAG"

config DIAGFWD_BRIDGE_CODE
	depends on USB_QCOM_DIAG_BRIDGE
	default y
	bool "Enable QSC/9K DIAG traffic over SMUX/HSIC"
	help
	 SMUX/HSIC Transport Layer for DIAG Router
endmenu

config LGE_DIAG_USB_ACCESS_LOCK
    boolean "feature for usb diag access lock"
    help
     this feature should be applied to meet usb diag lock requirement

    default n

config LGE_DIAG_ENABLE_SYSFS
    boolean "provide diag enable sysfs for user space"
    help
     diag enable sysfs value can define diag enable or disable

    default n

menu "LGE DM APP Support"

config LGE_DM_APP
	bool "LGE DM APP Support"
	default n
	depends on MACH_LGE
	help
	 LGE DM APP Support
endmenu

menu "LGE DM DEV Support"

config LGE_DM_DEV
    bool "LGE DM DEV Support"
    default n
    depends on MACH_LGE
    help
     LGE DM DEV Support
endmenu
```

## drivers/cpufreq/Kconfig.cpumods
```kconfig
#menu "CPU Controls"

config CPU_OVERCLOCK
	bool "Enable 2.572 Ghz CPU Overclock"
	default y
	help
	  Enabled CPU overclocking to 2.572 Ghz per core

config OC_ULTIMATE
	bool "Enable Ultimate Overclocking option"
	depends on CPU_OVERCLOCK
	default y
	help
	  Krait overclocking up to 2.8 GHz

config TURBO_BOOST
	bool "Enable CPU Turbo boost option"
	depends on CPU_OVERCLOCK
	default y
	help
	  This option allows overclocking of 2 cores to higher clock rate
	  than stock maximum.  When more than 2 cores are active, the clock
	  is limited to stock max speeds

config CPU_MAX_LIMIT
	bool "Allow to set force max/min freq"
	default n
	depends on !MSM_CPUFREQ_LIMITER
	help
	  This code is merged from Samsung DVFS code
	  It's allow us to set hard Freq limit and provide
	  interface for allowing OC or not!

config CPU_UNDERCLOCK
	bool "Enable CPU Underclocking option"
	default n
	help
	  Krait underclocking to 96Mhz

config CPU_VOLTAGE_TABLE
	bool "Enable CPU Voltage Table via sysfs for adjustements"
	default y
	help
	  Krait CPU User Votlage Control

#endmenu
```

## drivers/felica/Kconfig
```kconfig
#platform.team@lge.com	2011.01

comment "LGE Felica selection"

config LGE_FELICA
	bool "Felica driver"
	default n
	---help---
	LGE Felica related change

config LGE_FELICA_NFC
	bool "Felica NFC driver"
	default n
	---help---
	LGE Felica related change

config LGE_FELICA_ONLY
	bool "Felica only driver"
	default n
	---help---
	LGE Felica related change

config LGE_FELICA_KDDI
	bool "Felica KDDI driver"
	default n
	---help---
	LGE Felica related change

config LGE_FELICA_NFC_DCM
	bool "Felica DCM driver"
	default n
	---help---
	LGE Felica related change
```

## drivers/input/sensor/Kconfig
```kconfig
#
# Input core configuration
#
menuconfig INPUT_SENSOR
	bool "SENSOR"
	default y
	help
	  Say Y here, and a list of supported SENSORs will be displayed.
	  This option doesn't affect the kernel.

	  If unsure, say Y.

if INPUT_SENSOR

config SENSOR_LSM330
	bool "LSM330 Sensor(Acc + Gyr)"
	depends on I2C
	default n
	help
	  LSM330 Device Driver.

config SENSOR_APDS9950
	bool "APDS9950 combined als and proximity sensors"
	depends on I2C
	default n
	---help---
	Say Y here if you want to build a driver for Avago APDS9950
	combined ambient light and proximity sensor chip.

	To compile this driver as a module, choose M here: the
	module will be called apds9950. If unsure, say N here.

config SENSOR_AK8963
	bool "AK8963 compass support"
	default n
	depends on I2C
	help
	  If you say yes here you get support for Asahi Kasei's
	  orientation sensor AK8963.

config SENSOR_SHT21
	bool "SHT21 humidity sensor support"
	default n
	depends on I2C
	help
	  If you say yes here you get support for humidity
	  sensor SHT21.

config SENSOR_BMP18X
	bool "BMP18X digital pressure sensor"
	depends on I2C && SYSFS
	help
	  If you say yes here you get support for Bosch Sensortec
	  digital pressure sensors BMP085, BMP180 and BMP181.

	  To compile this driver as a module, choose M here: the
	  module will be called bmp18x-core.
endif
```

## drivers/mmc/Kconfig
```kconfig
#
# MMC subsystem configuration
#

menuconfig MMC
	tristate "MMC/SD/SDIO card support"
	depends on HAS_IOMEM
	help
	  This selects MultiMediaCard, Secure Digital and Secure
	  Digital I/O support.

	  If you want MMC/SD/SDIO support, you should say Y here and
	  also to your specific host controller driver.

config MMC_DEBUG
	bool "MMC debugging"
	depends on MMC != n
	help
	  This is an option for use by developers; most people should
	  say N here.  This enables MMC core and driver debugging.

config MMC_PERF_PROFILING
	bool "MMC performance profiling"
	depends on MMC != n
	default n
	help
	  If you say Y here, support will be added for collecting
	  performance numbers at the MMC Queue and Host layers.

config LGE_MMC_SD_USE_SDCC3
	bool "microSD use SDCC3 instead of SDCC2"
	depends on MMC != n
	help
	  If you use SDCC3 for microSD, you have to set Y in kernel/arch/arm/configs/XXXX_defconfig file.

config LGE_MMC_BKOPS_ENABLE
	bool "enable BKOPS for eMMC"
	depends on MMC != n
	help
	  If you want to use BKOPS for eMMC, you have to set Y in kernel/arch/arm/configs/XXXX_defconfig file.

# LGE_CHANGE_S : bohyun.jung@lge.com
config LGE_MMC_DYNAMIC_LOG
    bool "MMC debugging - enable logs through adb"
    default n
    help
        If you say Y here, developers can enable/disable mmc logs through adb
        by accessing /sys/module/mmc_core/parameters/debug_level
        ex. echo {debug_level} > /sys/module/mmc_core/parameters/debug_level
# LGE_CHANGE_E : bohyun.jung@lge.com

if MMC

source "drivers/mmc/core/Kconfig"

source "drivers/mmc/card/Kconfig"

source "drivers/mmc/host/Kconfig"

endif # MMC
```

## drivers/nfc/Kconfig
```kconfig
#
# Near Field Communication (NFC) devices
#

menu "Near Field Communication (NFC) devices"
	depends on NFC
endmenu

config LGE_NFC
	bool "NFC Device Enabled for LGE"
	default n

config LGE_NFC_PN544_C2
	bool "PN544 C2 NFC driver"
	depends on I2C
	select CRC_CCITT
	default n
	---help---
	  Say yes if you want PN544 Near Field Communication driver.
	  This is for i2c connected version. If unsure, say N here.

	  To compile this driver as a module, choose m here. The module will
	  be called pn544.

config LGE_NFC_PN544_C3
	bool "PN544 C3 NFC driver"
	depends on I2C
	select CRC_CCITT
	default n
	---help---
	  Say yes if you want PN544 Near Field Communication driver.
	  This is for i2c connected version. If unsure, say N here.

	  To compile this driver as a module, choose m here. The module will
	  be called pn544.

config LGE_NFC_PRESTANDBY
	bool "NFC STANBY MODE"
	default n
	---help---
	  Say yes if you want to change a power state of pn544 to stanby mode in Kernel.
	  If unsure, say N here.

config LGE_NFC_MULTICORE_FASTBOOT
	bool "NFC MultiThread"
	default n
	---help---
	  Say yes if multi thread is applied for pre-standby.
	  If unsure, say N here.

config LGE_NFC_SET_IRQ_WAKEUP
	bool "NFC Set IRQ wakeup when NFC ON"
	default n
	---help---
	  Say yes if Set IRQ Wakeup NFC ON.
	  If unsure, say N here.
	 
config LGE_NFC_DEBUG_MESSAGE
	bool "NFC Debug Message"
	default n

config LGE_NFC_HW_QCT_MSM72X7A
	bool "Qualcom MSM72X7A Chipset"
	default n

config LGE_NFC_HW_QCT_APQ8064
	bool "Qualcom APQ8064 Chipset"
	default n

config LGE_NFC_HW_QCT_MSM8960
	bool "Qualcom APQ8960 Chipset"
	default n

config LGE_NFC_HW_QCT_MSM8930
	bool "Qualcom MSM8930 Chipset"
	default n

config LGE_NFC_HW_QCT_MSM8660
	bool "Qualcom MSM8660 Chipset"
	default n

config LGE_NFC_HW_QCT_MSM8255
	bool "Qualcom MSM8255 Chipset"
	default n

config LGE_NFC_HW_TI_OMAP4430
	bool "TI OMAP4430 Chipset"
	default n

config LGE_NFC_HW_NV_AP3X
	bool "Nvidia AP3X Chipset"
	default n

config NFC_PN533
	tristate "NXP PN533 USB driver"
	depends on USB
	help
	  NXP PN533 USB driver.
	  This driver provides support for NFC NXP PN533 devices.

	  Say Y here to compile support for PN533 devices into the
	  kernel or say M to compile it as module (pn533).

config NFC_WILINK
	tristate "Texas Instruments NFC WiLink driver"
	depends on TI_ST && NFC_NCI
	help
	  This enables the NFC driver for Texas Instrument's BT/FM/GPS/NFC
	  combo devices. This makes use of shared transport line discipline
	  core driver to communicate with the NFC core of the combo chip.

	  Say Y here to compile support for Texas Instrument's NFC WiLink driver
	  into the kernel or say M to compile it as module.


config LGE_NFC_SONY_CXD2235AGG
	bool "CXD2235AGG NFC driver"
	#depends on I2C && UART
	default n
	---help---
	  Say yes if you want CDX2235AGG Near Field Communication driver.
	  This is for i2c & UART connected version. If unsure, say N here.

	  To compile this driver as a module, choose m here. The module will
	  be called CDX2235AGG.

config LGE_NFC_SONY_KDDI
	bool "CXD2235BGG NFC driver for kddi"
	#depends on I2C && UART
	default n
	---help---
	  Say yes if you want CDX2235AGG Near Field Communication driver.
	  This is for i2c & UART connected version. If unsure, say N here.

	  To compile this driver as a module, choose m here. The module will
	  be called CDX2235AGG.	  
source "drivers/nfc/snfc/Kconfig"
source "drivers/nfc/snfc_kddi/Kconfig"

config NFC_BCM2079X
	bool "Broadcom 2079X NFC Controller Driver"
	depends on I2C
	select CRC_CCITT
	help
	  Broadcom 2079X Near Field Communication controller support.
```

## drivers/nfc/snfc/Kconfig
```kconfig
##########################################################
#
#	Kconfig - NFC Driver (FOR CXD2235AGG)
#
##########################################################

config CXD2235AGG_GJ_KDDI
	tristate "CXD2235AGG NFC driver GJ_KDDI"
	#depends on UART
	#depends on I2C
	default n
	---help---
	  Say yes if you like to use CXD2235AGG through UART for GJ KDDI.
```

## drivers/platform/Kconfig
```kconfig
if X86
source "drivers/platform/x86/Kconfig"
endif
if ARCH_MSM
source "drivers/platform/msm/Kconfig"
endif
if MACH_LGE
source "drivers/platform/lge/Kconfig"
endif
```

## drivers/platform/lge/Kconfig
```kconfig
menu "LGE specific device drivers"
	depends on MACH_LGE

source "drivers/platform/lge/mock_power/Kconfig"

endmenu
```

## drivers/platform/lge/mock_power/Kconfig
```kconfig
config MOCK_POWER
	bool "LG mock power driver to test a power on mobile device"
	default n
	help
	  Say Y to enable LG mock power driver to test a power on mobile device.
	  This is used to test power supply interface with platform and is able
          to enable or disable in runtime even though a system uses a real battery.

config MOCK_POWER_DEBUGFS
	bool "LG mock power debugfs"
	depends on MOCK_POWER
	default n
	help
	  Say Y to support a debugfs for LG mock power.
```

## drivers/platform/lge/zwait/Kconfig
```kconfig
config ZERO_WAIT
	bool "LG Zero-Wait driver"
	depends on SYSFS && PM_SLEEP
	default n
	help
	  Say Y to enable LG Zero-Wait driver.

config ZERO_WAIT_DEBUGFS
	bool "LG Zero-Wait debugfs"
	depends on ZERO_WAIT
	default n
	help
	  Say Y to support debugfs for LG Zero-Wait.
```

## drivers/switch/Kconfig
```kconfig
menuconfig SWITCH
	tristate "Switch class support"
	help
	  Say Y here to enable switch class support. This allows
	  monitoring switches by userspace via sysfs and uevent.

if SWITCH

config SWITCH_GPIO
	tristate "GPIO Swith support"
	depends on GENERIC_GPIO
	help
	  Say Y here to enable GPIO based switch support.

config SWITCH_MAX1462X
	tristate "LGE Headset detection driver(MAX14628)"
	depends on MACH_LGE
	default n
	help
	  Say Y here to enable GPIO based switch support.

config SWITCH_MAX1462X_WA
	tristate "LGE Headset detection driver(MAX14628) workaround "
	depends on MACH_LGE
	default n
	help
	  Say Y here to enable GPIO based switch support.
endif # SWITCH

config INPUT_MAX14688
	tristate "MAXIM MAX14688 headset jack detector support"
	depends on MACH_LGE
	help
	  This option enables device driver support for MAX14688, a headset jack
	  detection IC.

	  To compile this driver as module, choose M here: the
	  module will be called max14688.
```

## drivers/usb/dwc3/Kconfig
```kconfig
config USB_DWC3
	tristate "DesignWare USB3 DRD Core Support"
	depends on (USB || USB_GADGET)
	select USB_OTG_UTILS
	select USB_XHCI_PLATFORM if USB_SUPPORT && USB_XHCI_HCD
	help
	  Say Y or M here if your system has a Dual Role SuperSpeed
	  USB controller based on the DesignWare USB3 IP Core.

	  If you choose to build this driver is a dynamically linked
	  module, the module will be called dwc3.ko.

if USB_DWC3

config USB_DWC3_DEBUG
	bool "Enable Debugging Messages"
	help
	  Say Y here to enable debugging messages on DWC3 Driver.

config USB_DWC3_VERBOSE
	bool "Enable Verbose Debugging Messages"
	depends on USB_DWC3_DEBUG
	help
	  Say Y here to enable verbose debugging messages on DWC3 Driver.

#CONFIG_USB_LGE_USB3_REDRIVER
config USB_LGE_USB3_REDRIVER
	bool "LGE specific USB3 Redriver feature"
	help
	 Say Y to enalbe LGE specific USB3 Redriver feature.
	default n

config USB_LGE_RELIABILITY
	bool "LGE reliability feature"
	help
	 kernel usb reliabilty feature 
	default n

config USB_LGE_LPM_STATE
	bool "LGE LPM state"
	help
	 no init lpm and keep no lpm state is added to previous DWC3 lpm state. 
	default n

#CONFIG_USB_DWC3_MSM_VZW_SUPPORT
config USB_DWC3_MSM_VZW_SUPPORT
	bool "VZW specific DWC3_MSM support in LGE Android"
	depends on USB_DWC3_MSM
	help
	  It supports VZW specific DWC3_MSM feature for USB BC 1.2 event. 
	  note that this must be used in VZW devices.

	  Say y if this must be needed.
	default n
endif
```
