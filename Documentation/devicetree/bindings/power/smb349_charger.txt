## Documentation/devicetree/bindings/power/smb349_charger.txt
```
Summit smb349 battery charger

The smb349 charger supports stack-cell battery charging.

The smb349 interface is via I2C bus.
The i2c slave 7-bit address is programmable at manufacture.

Node required properties:
- compatible:	Must be "summit,smb349-charger".
- reg:			The device 7-bit I2C address.
- summit,stat-gpio			gpio which smb349 STAT pin connects to.
- summit,chg-en-n-gpio		gpio which control charging enable.
- summit,chg-susp-n-gpio	gpio which control device shutdown
- summit,chg-current-ma		charging current in milliamps.
- summit,term-current-ma	charging termination current in milliamps.
							valid values are 100/200/300/400/500/600/700.
							A value of zero means no termination current.

Example:
	i2c@f9923000 {
		cell-index = <84>;
		compatible = "qcom,i2c-qup";
		reg = <0xf9923000 0x1000>;
		#address-cells = <1>;
		#size-cells = <0>;
		reg-names = "qup_phys_addr";
		interrupts = <0 95 0>;
		interrupt-names = "qup_err_intr";
		qcom,i2c-bus-freq = <100000>;
		qcom,i2c-src-freq = <24000000>;
		label = "blsp_10";

		smb349@2d {
			compatible = "summit,smb349-charger";
			reg = <0x2d>; /* 0x5A/0x5B */
			summit,stat-gpio = <&pm8941_gpios 30 0x02>;
			summit,chg-en-n-gpio = <&pm8941_gpios 10 0x00>;
			summit,chg-susp-n-gpio = <&pm8941_gpios 13 0x00>;
			summit,chg-current-ma = <1600>;
			summit,term-current-ma = <100>;
		};
	};
```

## arch/arm/mach-msm/lge/Kconfig
```kconfig
config MACH_LGE
	bool

menu "LGE Board Selection"

config MACH_MSM8974_LGPS11
	depends on ARCH_MSM8974
	select MACH_LGE
	bool "MSM8974 LGPS11"
	help
	  Support for the Qualcomm MSM8974 LGPS11 device.

config MACH_MSM8974_G2EVB
	depends on ARCH_MSM8974
	select MACH_LGE
	bool "MSM8974 G2-EVB"
	help
	  Support for the Qualcomm MSM8974 G2-EVB device.

config MACH_MSM8974_G2_KR
	depends on ARCH_MSM8974
	select MACH_LGE
	bool "MSM8974 G2 KR"
	help
	  Support for the Qualcomm MSM8974 G2 Korea device.

config MACH_MSM8974_G2_LGU
	depends on ARCH_MSM8974
	select MACH_LGE
	bool "MSM8974 G2 LGU"
	help
	  Support for the Qualcomm MSM8974 G2 LG Uplus device.

config MACH_MSM8974_G2_ATT
	depends on ARCH_MSM8974
	select MACH_LGE
	bool "MSM8974 G2 ATT"
	help
	  Support for the Qualcomm MSM8974 G2 AT&T device.

config MACH_MSM8974_G2_SKT
	depends on ARCH_MSM8974
	select MACH_LGE
	bool "MSM8974 G2 SKT"
	help
	  Support for the Qualcomm MSM8974 G2 SKT device.

config MACH_MSM8974_G2_KT
	depends on ARCH_MSM8974
	select MACH_LGE
	bool "MSM8974 G2 KT"
	help
	  Support for the Qualcomm MSM8974 G2 KT device.

config MACH_MSM8974_G2_VZW
	depends on ARCH_MSM8974
	select MACH_LGE
	bool "MSM8974 G2 VZW"
	help
	  Support for the Qualcomm MSM8974 G2 Verizon device.

config MACH_MSM8974_G2_SPR
	depends on ARCH_MSM8974
	select MACH_LGE
	bool "MSM8974 G2 SPR"
	help
	  Support for the Qualcomm MSM8974 G2 SPRINT device.

config MACH_MSM8974_G2_TMO_US
	depends on ARCH_MSM8974
	select MACH_LGE
	bool "MSM8974 G2 TMO_US"
	help
	  Support for the Qualcomm MSM8974 G2 TMUS device.

config MACH_MSM8974_G2_DCM
	depends on ARCH_MSM8974
	select MACH_LGE
	bool "MSM8974 G2 DCM"
	help
	  Support for the Qualcomm MSM8974 G2 DCM device.

config MACH_MSM8974_G2_KDDI
	depends on ARCH_MSM8974
	select MACH_LGE
	bool "MSM8974 G2 KDDI"
	help
	  Support for the Qualcomm MSM8974 G2 KDDI device.

config MACH_MSM8974_G2_OPEN_COM
	depends on ARCH_MSM8974
	select MACH_LGE
	bool "MSM8974 G2 OPEN_COM"
	help
	  Support for the Qualcomm MSM8974 G2 OPEN device.

config MACH_MSM8974_G2_OPT_AU
	depends on ARCH_MSM8974
	select MACH_LGE
	bool "MSM8974 G2 OPT AU"
	help
	  Support for the Qualcomm MSM8974 G2 OPEN device.

config MACH_MSM8974_G2_TEL_AU
	depends on ARCH_MSM8974
	select MACH_LGE
	bool "MSM8974 G2 TEL AU"
	help
	  Support for the Qualcomm MSM8974 G2 OPEN device.

config MACH_MSM8974_G2_CA
	depends on ARCH_MSM8974
	select MACH_LGE
	bool "MSM8974 G2 CA"
	help
	  Support for the Qualcomm MSM8974 G2 Canada device.

config MACH_MSM8974_G2_BELL
	depends on ARCH_MSM8974
	select MACH_LGE
	bool "MSM8974 G2 BELL"
	help
	  Support for the Qualcomm MSM8974 G2 BELL device.

config MACH_MSM8974_G2_TLS
	depends on ARCH_MSM8974
	select MACH_LGE
	bool "MSM8974 G2 TLS"
	help
	  Support for the Qualcomm MSM8974 G2 BELL device.

config MACH_MSM8974_G2_RGS
	depends on ARCH_MSM8974
	select MACH_LGE
	bool "MSM8974 G2 RGS"
	help
	  Support for the Qualcomm MSM8974 G2 BELL device.

config MACH_MSM8974_G2_VTR
	depends on ARCH_MSM8974
	select MACH_LGE
	bool "MSM8974 G2 VTR"
	help
	  Support for the Qualcomm MSM8974 G2 VTR device.
	  
config MACH_MSM8974_G2_WIN
	depends on ARCH_MSM8974
	select MACH_LGE
	bool "MSM8974 G2 WIN"
	help
	  Support for the Qualcomm MSM8974 G2 WIN device.

config MACH_MSM8974_Z_KR
	depends on ARCH_MSM8974
	select MACH_LGE
	bool "MSM8974 Z KR"
	help
	  Support for the Qualcomm MSM8974 Z Korea device.

config MACH_MSM8974_Z_LGU
	depends on ARCH_MSM8974
	select MACH_LGE
	bool "MSM8974 Z LGU"
	help
	  Support for the Qualcomm MSM8974 Z LG Uplus device.

config MACH_MSM8974_Z_US
	depends on ARCH_MSM8974
	select MACH_LGE
	bool "MSM8974 Z US"
	help
	  Support for the Qualcomm MSM8974 Z United State device.

config MACH_MSM8974_Z_SPR
	depends on ARCH_MSM8974
	select MACH_LGE
	bool "MSM8974 Z SPR"
	help
	  Support for the Qualcomm MSM8974 Z Sprint device.

config MACH_MSM8974_Z_TMO_US
	depends on ARCH_MSM8974
	select MACH_LGE
	bool "MSM8974 Z TMO US"
	help
	  Support for the Qualcomm MSM8974 TMUS device.

config MACH_MSM8974_Z_ATT_US
	depends on ARCH_MSM8974
	select MACH_LGE
	bool "MSM8974 Z ATT US"
	help
	  Support for the Qualcomm MSM8974 Z ATT device.

config MACH_MSM8974_VU3_KR
	depends on ARCH_MSM8974
	select MACH_LGE
	bool "MSM8974 VU3 KR"
	help
	  Support for the Qualcomm MSM8974 VU3 Korea device.

config MACH_MSM8974_VU3_LGU
	depends on ARCH_MSM8974
	select MACH_LGE
	bool "MSM8974 VU3 LGU"
	help
	  Support for the Qualcomm MSM8974 VU3 LG Uplus device.

config MACH_MSM8974_VU3_SKT
	depends on ARCH_MSM8974
	select MACH_LGE
	bool "MSM8974 VU3 SKT"
	help
	  Support for the Qualcomm MSM8974 VU3 SKT device.

config MACH_MSM8974_VU3_KT
	depends on ARCH_MSM8974
	select MACH_LGE
	bool "MSM8974 VU3 KT"
	help
	  Support for the Qualcomm MSM8974 VU3 KT device.

config MACH_MSM8974_Z_SKT
	depends on ARCH_MSM8974
	select MACH_LGE
	bool "MSM8974 Z SKT"
	help
	  Support for the Qualcomm MSM8974 Z SKT device.

config MACH_MSM8974_Z_KT
	depends on ARCH_MSM8974
	select MACH_LGE
	bool "MSM8974 Z KT"
	help
	  Support for the Qualcomm MSM8974 Z KT device.

config MACH_MSM8974_G2_OPEN_AME
	depends on ARCH_MSM8974
	select MACH_LGE
	bool "MSM8974 G2 OPEN_AME"
	help
	  Support for the Qualcomm MSM8974 G2 OPEN device.

config MACH_MSM8974_Z_KDDI
	depends on ARCH_MSM8974
	select MACH_LGE
	bool "MSM8974 Z KDDI"
	help
	  Support for the Qualcomm MSM8974 Z KDDI device.

endmenu

menu "LGE Specific Patches"

config LGE_USES_SMD_DS_TTY
	bool "Explicitly use smd tty driver for DS"
	default n
	depends on MSM_SMD_TTY && MACH_LGE
	help
	  In Qualcomm MSM8960, smd tty driver for ds(/dev/smd0) is not used.
	  Say yes if this tty driver must be used on LGE device. This is used
	  to connect smd channel in user space(for example, ATCMD processing).

config DEBUG_USER_INIT
	bool "Print debug messages for init process only"
	default n
	depends on DEBUG_USER
	help
	  Print the init process debug message only.

config LGE_BOOTLOADER_LOG
	tristate "Support LGE bootloader log"
	default n
	depends on MACH_LGE
	help
	  LGE bootloader log

config LGE_HANDLE_PANIC
	tristate "Support LGE Kernel Panic Handler"
	default n
	depends on MACH_LGE
	help
	  LGE Error handler

config LGE_MEMORY_INFO
	bool "Show Additional Memory Information"
	default n
	depends on MACH_LGE
	help
	  If you want to show additional memory information by /proc/meminfo or
	  /proc/zoneinfo, set this setting.
	  This configuration show page size for vmalloc, binder, kgsl, ion, and iommu.

config LGE_LCD_TUNING
	bool "lcd_gamma_tuning"
	default n
	depends on MACH_LGE
	help
	  Support LCD gamma tuning.

config LGE_BOOTLOADER_TIME_CHECKER
	bool "Show bootloader(LK, SBL) time"
	default n
	depends on MACH_LGE
	help
	  This shows the lk and sbl1 booting time in MSM8974.
	  If this feature is enabled, it should be check by adb shell.
	  Device Node : sys/module/lge_bootloader_time_checker/

config LGE_ECO_MODE
	tristate "Support LGE ECO Mode"
	default n
	depends on MACH_LGE
	help
	  LGE ECO mode support

config LGE_QFPROM_INTERFACE
	bool "Support qfprom interface"
	default n
	depends on MACH_LGE
	help
	  LGE QFPROM DRIVER.

config LGE_BNR_RECOVERY_REBOOT
	bool "Support PC suite BNR recovery reboot"
	default y
	depends on MACH_LGE
	help
	  Support PC suite BNR recovery reboot. bnr recovery mode
	  could be entered with reboot --bnr_recovery cmd.

config LGE_BOOST_GPIO
        bool "Control PM8941 GPIO_12 & GPIO_21"
        default y
        depends on MACH_LGE && SPMI
        help
          Control PM8941 GPIO_12 & GPIO_21 for boost IC

endmenu
```

## drivers/broadcast/Kconfig
```kconfig
# LGE Broadcast Device Driver Support

menu "LGE Broadcast Device Support"


config LGE_BROADCAST_ONESEG
	bool "1Seg Broadcast service"
	depends on (MACH_MSM8960_L_DCM)||(MACH_MSM8974_G2_DCM)||(MACH_MSM8974_G2_KDDI) || (MACH_MSM8974_Z_KDDI)
	default y
	help
	  Select this if you want to use Japanese 1Seg mobile broadcast service


config LGE_BROADCAST_TDMB
	bool "LGE broadcast TDMB device Driver"
	depends on (MACH_MSM8974_G2_KR)||(MACH_MSM8974_Z_KR)||(MACH_MSM8974_VU3_KR)
	default y
	help
	  Select this if you want to use TDMB broadcast service

source "drivers/broadcast/oneseg/Kconfig"
source "drivers/broadcast/tdmb/Kconfig"
endmenu
```

## drivers/broadcast/oneseg/Kconfig
```kconfig
#
# Broadcast Device Driver Support
#

menu "LGE Japanese Mobile Broadcast(ISDB-T 1seg/ISDB-Tmm 13seg) Device Support"
config LGE_BROADCAST_ONESEG_MB86A36K
	bool "1Seg broacast tuner chipset mb86a35s  device driver"
#	depends on LGE_BROADCAST_ONESEG && MACH_MSM8974_G2_DCM
	default n
	help
	  Select this if you want to use Japanese 1Seg mobile broadcast service

config LGE_BROADCAST_ONESEG_MB86A35S
	bool "1Seg broacast tuner chipset mb86a35s  device driver"
	depends on LGE_BROADCAST_ONESEG && MACH_APQ8064_J1D
	default y
	help
	  Select this if you want to use Japanese 1Seg mobile broadcast service
	  
config LGE_BROADCAST_ONESEG_FC8150
	bool "1Seg broacast tuner chipset fc8150 device driver"
	depends on LGE_BROADCAST_ONESEG && ( (MACH_APQ8064_J1KD) || (MACH_MSM8974_G2_DCM) || (MACH_MSM8974_G2_KDDI))
	default y
	help
	  Select this if you want to use Japanese 1Seg mobile broadcast service

config LGE_BROADCAST_ONESEG_TCC3530
	bool "1Seg broacast tuner chipset tcc3530  device driver"
	depends on LGE_BROADCAST_ONESEG && MACH_APQ8064_F9J
	default y
	help
	  Select this if you want to use Japanese 1Seg mobile broadcast service

config LGE_BROADCAST_ONESEG_TCC3535
	bool "1Seg broacast tuner chipset tcc3535  device driver"
	depends on LGE_BROADCAST_ONESEG && MACH_MSM8974_Z_KDDI
	default y
	help
	  Select this if you want to use Japanese 1Seg mobile broadcast service
	  
endmenu
```

## drivers/broadcast/oneseg/fc8150/Kconfig
```kconfig
#
# FC8150_DEVICE subsystem configuration
#

#menu "FC8150 support"

config FC8150_ISDB_T
	default n
	---help---
	  This driver implements the front-end of the Xen virtual
	  keyboard and mouse device driver.  It communicates with a back-end
	  in another domain.
  
#endmenu
```

## drivers/broadcast/oneseg/radio-mb86a35/Kconfig
```kconfig
#
# MB86A35S_DEVICE subsystem configuration
#

#menu "MB86A35S support"

config MB86A35S_ISDB_T
	default n
	---help---
	  This driver implements the front-end of the Xen virtual
	  keyboard and mouse device driver.  It communicates with a back-end
	  in another domain.
  
#endmenu
```

## drivers/broadcast/oneseg/radio-mb86a36k/Kconfig
```kconfig
#
# MB86A35S_DEVICE subsystem configuration
#

#menu "MB86A36K support"

config MB86A36K_ISDB_T
	default n
	---help---
	  This driver implements the front-end of the Xen virtual
	  keyboard and mouse device driver.  It communicates with a back-end
	  in another domain.
  
#endmenu
```

## drivers/broadcast/oneseg/raon_mtv250/Kconfig
```kconfig
#
# LG2102_DEVICE subsystem configuration
#

#menu "MTV250 support"

config MTV250_ISDB_T
	bool "Raon-tech MTV250 device driver"
	default n
	---help---
	  This driver implements the front-end of the Xen virtual
	  keyboard and mouse device driver.  It communicates with a back-end
	  in another domain.

#endmenu
```

## drivers/broadcast/tdmb/Kconfig
```kconfig
#menu "BROADCAST_DEVICE"

#
# Broadcast Device Driver Support
#

#menu "BROADCAST_DEVICE"

config LGE_BROADCAST_TDMB_T3A00
	bool "LGE broacast TDMB T3A00 device"
	depends on (LGE_BROADCAST_TDMB && MACH_MSM8974_VU3_KR)||(LGE_BROADCAST_TDMB && MACH_MSM8974_Z_KR)
	default y
	help
	  Select this if you want to use broadcast service

config LGE_BROADCAST_TDMB_FC8050
	bool "LGE broacast TDMB FC8050 device"
	depends on (LGE_BROADCAST_TDMB && MACH_MSM8974_G2_KR)
	default y
	help
	  Select this if you want to use broadcast service

config LGE_BROADCAST_TDMB_FC8050_Z
	bool "LGE broacast TDMB FC8050 device"
	depends on LGE_BROADCAST_TDMB && MACH_MSM8974_Z_KR
	default y
	help
	  Select this if you want to use broadcast service
	  
#config LGE_BROADCAST_TDMB_LG2102
#	bool "LGE broacast TDMB LG2102 device"
#	depends on LGE_BROADCAST_TDMB
#	default n
#	help
#	  Select this if you want to use broadcast service

#config LGE_BROADCAST_TDMB_T3900
#	bool "LGE broacast TDMB T3900 device"
#	depends on LGE_BROADCAST_TDMB
#	default y
#	help
#	  Select this if you want to use broadcast service

#config LGE_BROADCAST_TDMB_T39FX
#	bool "LGE broacast TDMB T39FX device"
#	depends on LGE_BROADCAST_TDMB
#	default y
#	help
#	  Select this if you want to use broadcast service
#endmenu
```

## drivers/broadcast/tdmb/fc8050_z/Kconfig
```kconfig
#
# LG2102_DEVICE subsystem configuration
#

#menu "FC8050 support"

config FC8050_TDMB
	default n
	---help---
	  This driver implements the front-end of the Xen virtual
	  keyboard and mouse device driver.  It communicates with a back-end
	  in another domain.

#endmenu
```

## drivers/broadcast/tdmb/fc8080/src/Kconfig
```kconfig
#
# LG2102_DEVICE subsystem configuration
#

#menu "FC8080 support"

config FC8080_TDMB
	default n
	---help---
	  This driver implements the front-end of the Xen virtual
	  keyboard and mouse device driver.  It communicates with a back-end
	  in another domain.

#endmenu
```

## drivers/broadcast/tdmb/t3a00/src/Kconfig
```kconfig
#
# T3A00_DEVICE subsystem configuration
#

#menu "T3A00 support"

config T3A00_TDMB
	default n
	---help---
	  This driver implements the front-end of the Xen virtual
	  keyboard and mouse device driver.  It communicates with a back-end
	  in another domain.
  
#endmenu
```
