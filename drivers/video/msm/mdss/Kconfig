## drivers/video/msm/mdss/Kconfig
```kconfig
config FB_MSM_MDSS_WRITEBACK
	bool "MDSS Writeback Panel"
	---help---
	The MDSS Writeback Panel provides support for routing the output of
	MDSS frame buffer driver and MDP processing to memory.

config FB_MSM_MDSS_HDMI_PANEL
	depends on FB_MSM_MDSS
	bool "MDSS HDMI Tx Panel"
	default n
	---help---
	The MDSS HDMI Panel provides support for transmitting TMDS signals of
	MDSS frame buffer data to connected hdmi compliant TVs, monitors etc.

config FB_MSM_MDSS_HDMI_MHL_SII8334
	depends on FB_MSM_MDSS_HDMI_PANEL
	bool 'MHL SII8334 support '
	default n
	---help---
	  Support the HDMI to MHL conversion.
	  MHL (Mobile High-Definition Link) technology
	  uses USB connector to output HDMI content
config LGE_ESD_CHECK
	bool "Enable sysfs for ESD check"
	default n
config LGE_SUPPORT_LCD_MAKER_ID
	depends on MACH_LGE
	default n
	bool "LGE LCD MAKER ID support configuration"
	help
	Say Y here to enable support for LCD MAKER ID lge feature.
config LCD_KCAL
	depends on MACH_LGE
	bool "Enable sysfs for LCD KCAL"
	default n
config MACH_MSM8974_A1
	depends on MACH_LGE
	bool "LGE LCD support configuration for A1"
	default n
config LGE_OLED_IMG_TUNING
	depends on (MACH_MSM8974_Z_KR || MACH_MSM8974_Z_US || MACH_MSM8974_Z_KDDI) && OLED_SUPPORT
	bool "Enable sysfs for OLED image tuning"
	default y
	---help---
	Support the image tuning for the LGD OLED Panel.
```

## drivers/video/slimport/Kconfig
```kconfig
config SLIMPORT_ANX7808
	tristate "Analogix Slimport transmitter ANX7808 support"
	help
	  Slimport Transmitter is a HD video transmitter chip
	  over micro-USB connector for smartphone device.

config SLIMPORT_DYNAMIC_HPD
	tristate "ANX7808 support for dynamic HDMI HPD control"
	depends on SLIMPORT_ANX7808
	help
	Slimport set HPD when cable is connected,
	HDMI clk is off during slimport cable is not connected

config SLIMPORT_ANX7805
	tristate "Analogix Slimport transmitter ANX7805 support"
	help
	  Slimport Transmitter is a HD video transmitter chip
	  over micro-USB connector for smartphone device.
```

## init/Kconfig.stockmod
```kconfig
#menu "StockMOD Kernel Customisations"

choice
    prompt "Compiler optimization level"
    default CC_OPTIMIZE_FOR_SIZE
    help
      This option selects the gcc compiler optimization level.

    config CC_OPTIMIZE_FOR_SIZE
        bool "Optimize for size -Os"
        help
         Enabling this option will pass "-Os" instead of "-O2" to gcc
         resulting in a smaller kernel.
        

    config CC_OPTIMIZE_FOR_NORMAL
        bool "Optimize normally -O2"
        help
         Enabling this option will pass "-O2" to gcc
         resulting in a larger kernel compared to -Os but with possible,
         minor performance improvements.
        
         This is the recommended setting
        

    config CC_OPTIMIZE_FOR_SPEED
        bool "Optimize for speed -O3"
        help
         Enabling this option will pass "-O3" to gcc
         resulting in a larger kernel but possible higher performance
         compared with -O2
        
         -O3 can cause problems with applications however and is not recommended

endchoice

#endmenu
```

## security/ccsecurity/Kconfig
```kconfig
config CCSECURITY
	bool "CCSecurity support"
	default n
	help
	  Say Y here to support non-LSM version of TOMOYO Linux.
	  http://tomoyo.sourceforge.jp/

config CCSECURITY_LKM
	bool "Compile as loadable kernel module"
	default n
	depends on CCSECURITY && MODULES
	help
	  This version of TOMOYO depends on patching the kernel source in order
	  to insert some hooks which LSM does not provide. Therefore,
	  recompiling the kernel is inevitable. But if you want to keep
	  vmlinux's size as small as possible, you can compile most part of
	  TOMOYO as a loadable kernel module by saying Y here.

config CCSECURITY_DISABLE_BY_DEFAULT
	bool "Disable by default"
	default n
	depends on CCSECURITY
	help
	  Say Y here if you want TOMOYO disabled by default.
	  To enable TOMOYO, pass ccsecurity=on to kernel command line.
	  To disable TOMOYO, pass ccsecurity=off to kernel command line.

config CCSECURITY_USE_EXTERNAL_TASK_SECURITY
	bool "Do not modify 'struct task_struct' in order to keep KABI"
	default n
	depends on CCSECURITY
	help
	  Say Y here if you want to keep KABI for prebuilt kernel modules
	  unchanged. TOMOYO needs "struct ccs_domain_info *" and "u32" for each
	  "struct task_struct". But embedding these variables into
	  "struct task_struct" breaks KABI for prebuilt kernel modules (which
	  means that you will need to rebuild prebuilt kernel modules).
	  If you say Y here, these variables are managed outside
	  "struct task_struct" rather than embedding into "struct task_struct",
	  but accessing these variables becomes slower because lookup operation
	  is performed every time the current thread needs to access them.

config CCSECURITY_MAX_ACCEPT_ENTRY
	int "Default maximal count for learning mode"
	default 2048
	range 0 2147483647
	depends on CCSECURITY
	help
	  This is the default value for maximal ACL entries
	  that are automatically appended into policy at "learning mode".
	  Some programs access thousands of objects, so running
	  such programs in "learning mode" dulls the system response
	  and consumes much memory.
	  This is the safeguard for such programs.

config CCSECURITY_MAX_AUDIT_LOG
	int "Default maximal count for audit log"
	default 1024
	range 0 2147483647
	depends on CCSECURITY
	help
	  This is the default value for maximal entries for
	  audit logs that the kernel can hold on memory.
	  You can read the log via /proc/ccs/audit.
	  If you don't need audit logs, you may set this value to 0.

config CCSECURITY_OMIT_USERSPACE_LOADER
	bool "Activate without calling userspace policy loader."
	default n
	depends on CCSECURITY
	---help---
	  Say Y here if you want to activate access control as soon as built-in
	  policy was loaded. This option will be useful for systems where
	  operations which can lead to the hijacking of the boot sequence are
	  needed before loading the policy. For example, you can activate
	  immediately after loading the fixed part of policy which will allow
	  only operations needed for mounting a partition which contains the
	  variant part of policy and verifying (e.g. running GPG check) and
	  loading the variant part of policy. Since you can start using
	  enforcing mode from the beginning, you can reduce the possibility of
	  hijacking the boot sequence.

	  If you say Y to both "Compile as loadable kernel module" option and
	  "Activate without calling userspace policy loader." option, be sure
	  to excplicitly load the kernel module from the userspace, for
	  the kernel will not call /sbin/ccs-init when /sbin/init starts.

config CCSECURITY_POLICY_LOADER
	string "Location of userspace policy loader"
	default "/sbin/ccs-init"
	depends on CCSECURITY
	depends on !CCSECURITY_OMIT_USERSPACE_LOADER
	---help---
	  This is the default pathname of policy loader which is called before
	  activation. You can override this setting via CCS_loader= kernel
	  command line option.

config CCSECURITY_ACTIVATION_TRIGGER
	string "Trigger for calling userspace policy loader"
	default "/sbin/init"
	depends on CCSECURITY
	depends on !CCSECURITY_OMIT_USERSPACE_LOADER
	---help---
	  This is the default pathname of activation trigger.
	  You can override this setting via CCS_trigger= kernel command line
	  option. For example, if you pass init=/bin/systemd option, you may
	  want to also pass CCS_trigger=/bin/systemd option.

	  Say Y here if you want to enable only specific functionality in order
	  to reduce object file size.

config CCSECURITY_FILE_READDIR
	bool "Enable readdir operation restriction."
	default y
	depends on CCSECURITY
	---help---
	  Say Y here if you want to enable analysis/restriction of opening
	  directories for reading. Reading directory entries is a commonly
	  requested operation and damage caused by not restricting it as MAC
	  might be acceptable for you.

config CCSECURITY_FILE_GETATTR
	bool "Enable getattr operation restriction."
	default y
	depends on CCSECURITY
	---help---
	  Say Y here if you want to enable analysis/restriction of getting
	  information of files. Getting file's information is a commonly
	  requested operation and damage caused by not restricting it as MAC
	  might be acceptable for you.

config CCSECURITY_NETWORK
	bool "Enable socket operation restriction."
	default y
	depends on NET
	depends on CCSECURITY
	---help---
	  Say Y here if you want to enable analysis/restriction of INET and
	  UNIX domain socket's operations.

config CCSECURITY_CAPABILITY
	bool "Enable non-POSIX capability operation restriction."
	default y
	depends on CCSECURITY
	---help---
	  Say Y here if you want to enable analysis/restriction of non-POSIX
	  capabilities.

config CCSECURITY_IPC
	bool "Enable IPC operation restriction."
	default y
	depends on CCSECURITY
	---help---
	  Say Y here if you want to enable analysis/restriction of sending
	  signals.

config CCSECURITY_MISC
	bool "Enable environment variable names restriction."
	default y
	depends on CCSECURITY
	---help---
	  Say Y here if you want to enable analysis/restriction of environment
	  variable names passed upon program execution request.

config CCSECURITY_TASK_EXECUTE_HANDLER
	bool "Enable execute handler functionality."
	default y
	depends on CCSECURITY
	---help---
	  Say Y here if you want to enable execute handler functionality.

config CCSECURITY_TASK_DOMAIN_TRANSITION
	bool "Enable domain transition without program execution request."
	default y
	depends on CCSECURITY
	---help---
	  Say Y here if you want to enable domain transition without involving
	  program execution request.

config CCSECURITY_PORTRESERVE
       bool "Enable local port reserver."
       default y
       depends on NET
       depends on CCSECURITY
       ---help---
	 Say Y here if you want to implement
	 /proc/sys/net/ipv4/ip_local_reserved_ports as a MAC policy.

config CCSECURITY_NETWORK_RECVMSG
	def_bool CCSECURITY_NETWORK
```
