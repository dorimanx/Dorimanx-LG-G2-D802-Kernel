/*
 * Copyright (c) 2012, The Linux Foundation. All rights reserved.
 *
 * This program is free software; you can redistribute it and/or modify
 * it under the terms of the GNU General Public License version 2 and
 * only version 2 as published by the Free Software Foundation.
 *
 * This program is distributed in the hope that it will be useful,
 * but WITHOUT ANY WARRANTY; without even the implied warranty of
 * MERCHANTABILITY or FITNESS FOR A PARTICULAR PURPOSE.  See the
 * GNU General Public License for more details.
 */

/include/ "../skeleton.dtsi"

&soc {
	qcom,cci@fda0C000 {
		qcom,camera@20 {
			compatible = "qcom,imx135";
			reg = <0x20 0x0>;
			qcom,csi-if = <1>;
			qcom,csid-core = <0>;
			qcom,flash-type = <0>;
			qcom,mount-angle = <90>;
			qcom,sensor-name = "imx135";
			cam_vdig-supply = <&pm8941_l3>;
			cam_vana-supply = <&pm8941_l17>;
			cam_vio-supply = <&pm8941_lvs2>;
			cam_vaf-supply = <&pm8941_l23>;
			qcom,cam-vreg-name = "cam_vdig", "cam_vana", "cam_vaf";
			qcom,cam-vreg-type = <0 0 0>;
			// Need to be changed the AF setting value as LGIT module: 1.8V, Sony module: 2.8V
			qcom,cam-vreg-min-voltage = <1225000 2850000 3000000>;
			qcom,cam-vreg-max-voltage = <1225000 2850000 3000000>;
			qcom,cam-vreg-op-mode = <105000 80000 100000>;
			qcom,gpio-no-mux = <0>;
			// MAIN_CAM_MCLK, Need to be set as 24MHz, 19.2MHz is set temporarily.
			gpios = <&msmgpio 15 0>,
				<&msmgpio 19 0>, // CAM0_I2C_SDA
				<&msmgpio 20 0>, // CAM0_I2C_SCL
				<&msmgpio 90 0>; // MAIN_CAM_RESET
			qcom,gpio-common-tbl-num = <0 1 2>;
			qcom,gpio-common-tbl-flags = <1 1 1>;
			qcom,gpio-common-tbl-label = "CAMIF_MCLK",
				"CAMIF_I2C_DATA",
				"CAMIF_I2C_CLK";
			qcom,gpio-req-tbl-num = <3>;
			qcom,gpio-req-tbl-flags = <0>;
			qcom,gpio-req-tbl-label = "CAM_RESET1";
			qcom,gpio-set-tbl-num = <3 3>;
			qcom,gpio-set-tbl-flags = <0 2>;
			qcom,gpio-set-tbl-delay = <1000 30000>;
			qcom,csi-lane-assign = <0x4320>;
			qcom,csi-lane-mask = <0x1F>;
			qcom,csi-phy-sel = <0>;
			qcom,camera-type = <0>;
			qcom,sensor-type = <0>;
			qcom,cci-master = <0>;
		};
	qcom,camera@6c {
			status = "ok";
			compatible = "qcom,imx132";
			reg = <0x6c 0x0>;
			qcom,csi-if = <1>;
			qcom,csid-core = <0>;
			qcom,flash-type = <0>;
			qcom,mount-angle = <0>;
			qcom,sensor-name = "imx132";
			cam_vdig-supply = <&pm8941_l3>;
			cam_vana-supply = <&pm8941_l17>;
			cam_vio-supply = <&pm8941_lvs2>;
			qcom,cam-vreg-name = "cam_vdig", "cam_vana";
			qcom,cam-vreg-type = <0 0>;
			qcom,cam-vreg-min-voltage = <1225000 2850000>;
			qcom,cam-vreg-max-voltage = <1225000 2850000>;
			qcom,cam-vreg-op-mode = <105000 80000>;
			qcom,gpio-no-mux = <0>;
			gpios = <&msmgpio 17 0>, //VT_CAM_MCLK
				<&msmgpio 19 0>, //VT_CAM_I2C_SDA temporarily
				<&msmgpio 20 0>, //VT_CAM_I2C_SCL temporarily
				<&msmgpio 18 0>; //VT_CAM_RESET
			qcom,gpio-common-tbl-num = <0 1 2>;
			qcom,gpio-common-tbl-flags = <1 1 1>;
			qcom,gpio-common-tbl-label = "CAMIF_MCLK",
						     "CAMIF_I2C_DATA",
						     "CAMIF_I2C_CLK";
			qcom,gpio-req-tbl-num = <3>;
			qcom,gpio-req-tbl-flags = <0>;
			qcom,gpio-req-tbl-label = "CAM_RESET1";
			qcom,gpio-set-tbl-num = <3 3>;
			qcom,gpio-set-tbl-flags = <0 2>;
			qcom,gpio-set-tbl-delay = <1000 4000>;
			qcom,csi-lane-assign = <0x4320>;
			qcom,csi-lane-mask = <0x3>;
			qcom,csi-phy-sel = <2>; //MSM8974 pin name
			qcom,camera-type = <1>;
			qcom,sensor-type = <0>;
			qcom,cci-master = <1>;
		};
	};
};
