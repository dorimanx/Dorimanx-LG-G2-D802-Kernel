/* Copyright (c) 2012, Code Aurora Forum. All rights reserved.
 *
 * This program is free software; you can redistribute it and/or modify
 * it under the terms of the GNU General Public License version 2 and
 * only version 2 as published by the Free Software Foundation.
 *
 * This program is distributed in the hope that it will be useful,
 * but WITHOUT ANY WARRANTY; without even the implied warranty of
 * MERCHANTABILITY or FITNESS FOR A PARTICULAR PURPOSE.  See the
 * GNU General Public License for more details.
 */

/dts-v1/;

/include/ "../msm8974-lge-common/msm8974-lge.dtsi"
/include/ "msm8974-lgps11.dtsi"

/ {
	model = "Qualcomm MSM 8974 MTP";
	compatible = "qcom,msm8974";
	qcom,msm-id = <126 100 0>;
};

