/* Copyright (c) 2012, Code Aurora Forum. All rights reserved.
 *
 * This program is free software; you can redistribute it and/or modify
 * it under the terms of the GNU General Public License version 2 and
 * only version 2 as published by the Free Software Foundation.
 *
 * This program is distributed in the hope that it will be useful,
 * but WITHOUT ANY WARRANTY; without even the implied warranty of
 * MERCHANTABILITY or FITNESS FOR A PARTICULAR PURPOSE.  See the
 * GNU General Public License for more details.
 */

&mdss_dsi0 {
	qcom,dsi-pref-prim-pan = <&mdss_dsi_b1_lgd_cmd>;
};

&soc {
	i2c@f9967000 {
		lm3630@38 {
			status = "ok";
            lm3630,lcd_bl_en = <&msmgpio 91 0x00>;
			lm3630,enable_pwm = <1>;
			lm3630,blmap = <
			2 2 2 2 2 2 2 2 2 2 2 2 2 2 2 
			2 2 2 2 2 2 2 2 2 2 2 2 2 2 2 
			2 2 2 2 2 2 2 2 3 3 3 3 3 3 3 
			3 3 3 4 4 4 4 4 4 4 4 4 4 4 4 
			4 4 4 4 5 5 5 5 5 5 5 6 6 6 6 
			6 6 6 6 7 7 7 7 7 7 7 8 8 8 8 
			9 9 11 11 11 12 12 12 12 13 13 13 13 14 14 
			14 15 15 16 16 17 17 19 20 20 21 22 23 24 
			25 25 27 27 28 28 29 29 30 30 31 31 32 33 34 
			34 35 36 37 38 40 41 42 43 44 45 46 47 48 49 
			49 50 51 53 54 56 58 60 61 62 63 64 65 66 67 
			67 68 69 70 71 72 73 74 75 76 77 78 78 79 80 
			81 83 85 87 89 90 91 92 93 94 96 96 98 100 102 105 
			106 108 110 112 114 116 118 120 122 123 124 125 126 127 130 
			132 134 136 138 139 140 142 144 146 148 150 153 156 159 162 
			164 166 168 170 172 174 176 178 182 185 187 189 191 193 195 
			196 199 202 204 207 210 213 216 219 220 222 225 228 231 234 237>;
			revision = "...";
		};
	};
};
