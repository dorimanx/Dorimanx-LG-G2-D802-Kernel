/* Copyright (c) 2012, Code Aurora Forum. All rights reserved.
 *
 * This program is free software; you can redistribute it and/or modify
 * it under the terms of the GNU General Public License version 2 and
 * only version 2 as published by the Free Software Foundation.
 *
 * This program is distributed in the hope that it will be useful,
 * but WITHOUT ANY WARRANTY; without even the implied warranty of
 * MERCHANTABILITY or FITNESS FOR A PARTICULAR PURPOSE.  See the
 * GNU General Public License for more details.
 */

/* [NFC][byunggu.kang@lge.com], 2013-10-09, NFC Bring up for B1 */
&soc {
	i2c@f9967000 {
		pn547@28 {
			compatible = "nxp,pn547";
			status = "disable";
			reg = <0x28>;
			nxp,i2c-pull-up = <1>;
			interrupt-parent = <&msmgpio>;
			interrupts = <59 0x2>;
			nxp,gpio_sda = <&msmgpio 83 0x00>;
			nxp,gpio_scl = <&msmgpio 84 0x00>;
			nxp,gpio_ven = <&msmgpio 94 0x00>;
			nxp,gpio_mode = <&msmgpio 92 0x00>;
			nxp,gpio_irq = <&msmgpio 59 0x00>;
		};
	};
};
