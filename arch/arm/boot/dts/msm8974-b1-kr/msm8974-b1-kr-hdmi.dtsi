/* Copyright (c) 2012, Code Aurora Forum. All rights reserved.
 *
 * This program is free software; you can redistribute it and/or modify
 * it under the terms of the GNU General Public License version 2 and
 * only version 2 as published by the Free Software Foundation.
 *
 * This program is distributed in the hope that it will be useful,
 * but WITHOUT ANY WARRANTY; without even the implied warranty of
 * MERCHANTABILITY or FITNESS FOR A PARTICULAR PURPOSE.  See the
 * GNU General Public License for more details.
 */

&soc {
	qcom,hdmi_tx@fd922100 {
		status = "ok";
	};

	i2c@f9967000 {
		analogix_anx7808@72 {
			status = "ok";
			analogix,reset-gpio    = <&msmgpio      89 0x00>; // SLIMPORT_RESET_N
			analogix,irq-gpio      = <&msmgpio      28 0x00>; // SLIMPORT_INT
			analogix,p-dwn-gpio    = <&pm8941_gpios 14 0x0>;  // ANX_PDWN_CTL
			analogix,cbl-det-gpio  = <&pm8941_gpios 13 0x0>;  // SLIMPORT_CBL_DET
			analogix,v10-ctrl-gpio = <&pm8941_gpios 8  0x0>;  // SLIMPORT_IO_EN
			analogix,v33-ctrl-gpio = <&pm8941_gpios 26 0x0>;  // SLIMPORT_AVDD_EN
		};
	};
};
