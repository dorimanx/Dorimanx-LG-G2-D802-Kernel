/* Copyright (c) 2012, Code Aurora Forum. All rights reserved.
 *
 * This program is free software; you can redistribute it and/or modify
 * it under the terms of the GNU General Public License version 2 and
 * only version 2 as published by the Free Software Foundation.
 *
 * This program is distributed in the hope that it will be useful,
 * but WITHOUT ANY WARRANTY; without even the implied warranty of
 * MERCHANTABILITY or FITNESS FOR A PARTICULAR PURPOSE.  See the
 * GNU General Public License for more details.
 */

/* [BT][younghyun.kwon@lge.com], Config BLSP2, UART10 and  bt sleep */

/ {
	aliases{
		uart99 = &uart10;
	};

	uart10: uart@f9960000 {
		compatible = "qcom,msm-hsuart-v14";
		status = "ok";
		reg = <0xf9960000 0x1000>,
			<0xf9944000 0x19000>;
		reg-names = "core_mem", "bam_mem";
		interrupts = <0 116 0>, <0 239 0>;
		interrupt-names = "core_irq", "bam_irq";

		qcom,tx-gpio = <&msmgpio 53 0x00>;
		qcom,rx-gpio = <&msmgpio 54 0x00>;
		qcom,cts-gpio = <&msmgpio 55 0x00>;
		qcom,rfr-gpio = <&msmgpio 56 0x00>;

		qcom,bam-tx-ep-pipe-index = <6>;
		qcom,bam-rx-ep-pipe-index = <7>;

		qcom,msm-bus,name = "uart10";
		qcom,msm-bus,num-cases = <2>;
		qcom,msm-bus,active-only = <0>;
		qcom,msm-bus,num-paths = <1>;
		qcom,msm-bus,vectors-KBps =
				<84 512 0 0>,
				<84 512 500 800>;
	};

	/* To register A1 BT wake-up devices for BT sleep */
	bt_sleep {
		compatible = "lge,bcm_bluesleep";
		host-wake-gpio = <&msmgpio 42 0>;
		ext-wake-gpio = <&msmgpio 62 0>;
		interrupt-parent = <&msmgpio>;
		interrupts = <42 0>;
		interrupt-names = "host_wake";
	};
};
